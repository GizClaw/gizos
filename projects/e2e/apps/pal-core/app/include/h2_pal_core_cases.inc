H2_PAL_CORE_CASE("pal.core.memory.lifecycle")
H2_PAL_CORE_CASE("pal.core.log.output")
H2_PAL_CORE_CASE("pal.core.time.monotonic")
H2_PAL_CORE_CASE("pal.core.time.wall-read")
H2_PAL_CORE_CASE("pal.core.time.wall-set")
H2_PAL_CORE_CASE("pal.core.timer.oneshot")
H2_PAL_CORE_CASE("pal.core.timer.lifecycle")
H2_PAL_CORE_CASE("pal.core.task.lifecycle")
H2_PAL_CORE_CASE("pal.core.queue.transfer")
H2_PAL_CORE_CASE("pal.core.queue.boundaries")
H2_PAL_CORE_CASE("pal.core.mutex.lifecycle")
H2_PAL_CORE_CASE("pal.core.semaphore.boundaries")
H2_PAL_CORE_CASE("pal.core.condition.signal")
H2_PAL_CORE_CASE("pal.core.condition.bounded-wait")
H2_PAL_CORE_CASE("pal.core.concurrency.mpmc")
H2_PAL_CORE_CASE("pal.core.system-event.lifecycle")
H2_PAL_CORE_CASE("pal.core.firmware-info.current")
H2_PAL_CORE_CASE("pal.core.queue.close-wake")
H2_PAL_CORE_CASE("pal.core.semaphore.wake")
H2_PAL_CORE_CASE("pal.core.api.arguments")
H2_PAL_CORE_CASE("pal.core.memory.churn-alignment")
H2_PAL_CORE_CASE("pal.core.task.once-context")
H2_PAL_CORE_CASE("pal.core.task.join-running")
H2_PAL_CORE_CASE("pal.core.task.join-completed")
H2_PAL_CORE_CASE("pal.core.task.churn")
H2_PAL_CORE_CASE("pal.core.task.batch-churn")
H2_PAL_CORE_CASE("pal.core.task.stack-bounds")
H2_PAL_CORE_CASE("pal.core.task.start-failure")
H2_PAL_CORE_CASE("pal.core.task.partial-start")
H2_PAL_CORE_CASE("pal.core.queue.copy-buffered-close")
H2_PAL_CORE_CASE("pal.core.queue.sender-close")
H2_PAL_CORE_CASE("pal.core.queue.reset-wake")
H2_PAL_CORE_CASE("pal.core.mutex.contention")
H2_PAL_CORE_CASE("pal.core.semaphore.waiters")
H2_PAL_CORE_CASE("pal.core.condition.broadcast")
H2_PAL_CORE_CASE("pal.core.condition.generations")
H2_PAL_CORE_CASE("pal.core.system-event.external-unsubscribe")
H2_PAL_CORE_CASE("pal.core.system-event.self-unsubscribe")
H2_PAL_CORE_CASE("pal.core.timer.isolation")
H2_PAL_CORE_CASE("pal.core.timer.churn")
H2_PAL_CORE_CASE("pal.core.resources.recovered")
